## CMakeLists.txt
```
# SPDX-License-Identifier: Apache-2.0

cmake_minimum_required(VERSION 3.20.0)
find_package(Zephyr REQUIRED HINTS $ENV{ZEPHYR_BASE})

project(bms_helper_test)

FILE(GLOB app_sources src/*.c)
target_sources(app PRIVATE ${app_sources})
```

## prj.conf
```kconfig
# SPDX-License-Identifier: Apache-2.0

CONFIG_ZTEST=y
CONFIG_ZTEST_NEW_API=y
```

## src/interpolation.c
```c
/*
 * Copyright (c) The Libre Solar Project Contributors
 *
 * SPDX-License-Identifier: Apache-2.0
 */

#include "helper.h"

#include <stdio.h>

#include <zephyr/ztest.h>

ZTEST(interpolation, test_increasing)
{
    float a[] = { 1, 2, 3, 4, 5 };
    float b[] = { 2, 4, 6, 8, 10 };

    float value_b = interpolate(a, b, sizeof(a) / sizeof(float), 1.75);
    zassert_equal(3.5F, value_b);

    value_b = interpolate(a, b, sizeof(a) / sizeof(float), -1);
    zassert_equal(2.0F, value_b);

    value_b = interpolate(a, b, sizeof(a) / sizeof(float), 6);
    zassert_equal(10.0F, value_b);
}

ZTEST(interpolation, test_decreasing)
{
    float a[] = { 5, 4, 3, 2, 1 };
    float b[] = { 2, 4, 6, 8, 10 };

    float value_b = interpolate(a, b, sizeof(a) / sizeof(float), 1.75);
    zassert_equal(8.5F, value_b);

    value_b = interpolate(a, b, sizeof(a) / sizeof(float), -1);
    zassert_equal(10.0F, value_b);

    value_b = interpolate(a, b, sizeof(a) / sizeof(float), 6);
    zassert_equal(2.0F, value_b);
}

ZTEST_SUITE(interpolation, NULL, NULL, NULL, NULL, NULL);
```

## src/is_empty.c
```c
/*
 * Copyright (c) The Libre Solar Project Contributors
 *
 * SPDX-License-Identifier: Apache-2.0
 */

#include "helper.h"

#include <stdio.h>

#include <zephyr/ztest.h>

ZTEST(is_empty, test_empty)
{
    float a[] = { 0.0, 0.0, 0.0, 0.0, 0.0, 0.0, 0.0, 0.0 };
    zassert_true(is_empty((uint8_t *)a, sizeof(a)));

#if __SIZEOF_POINTER__ == 4
    uint8_t b[] = { 0, 0, 0 };
#elif __SIZEOF_POINTER__ == 8
    uint8_t b[] = { 0, 0, 0, 0, 0, 0, 0 };
#endif
    zassert_true(is_empty((uint8_t *)b, sizeof(b)));
}

ZTEST(is_empty, test_filled_last_element)
{
    float a[] = { 0.0, 0.0, 0.0, 0.0, 0.0, 0.0, 0.0, 0.0001 };
    zassert_false(is_empty((uint8_t *)a, sizeof(a)));

#if __SIZEOF_POINTER__ == 4
    uint8_t b[] = { 0, 0, 1 };
#elif __SIZEOF_POINTER__ == 8
    uint8_t b[] = { 0, 0, 0, 0, 0, 0, 1 };
#endif
    zassert_false(is_empty((uint8_t *)b, sizeof(b)));
}

ZTEST(is_empty, test_filled_first_element)
{
    float a[] = { 0.0001, 0.0, 0.0, 0.0, 0.0, 0.0, 0.0, 0.0 };
    zassert_false(is_empty((uint8_t *)a, sizeof(a)));

#if __SIZEOF_POINTER__ == 4
    uint8_t b[] = { 1, 0, 0 };
#elif __SIZEOF_POINTER__ == 8
    uint8_t b[] = { 1, 0, 0, 0, 0, 0, 0 };
#endif
    zassert_false(is_empty((uint8_t *)b, sizeof(b)));
}

ZTEST(is_empty, test_unaligned_access)
{

    uint8_t a[] = { 0, 0, 0, 0, 0, 0, 0, 0, 0, 0, 0, 0, 0 };
    zassert_true(is_empty(((uint8_t *)a) + 1, sizeof(a) - 1));

    uint8_t b[] = { 0, 0, 0, 0, 0, 0, 0, 0, 0, 0, 0, 0, 1 };
    zassert_false(is_empty(((uint8_t *)b) + 1, sizeof(b) - 1));
}

ZTEST_SUITE(is_empty, NULL, NULL, NULL, NULL, NULL);
```
