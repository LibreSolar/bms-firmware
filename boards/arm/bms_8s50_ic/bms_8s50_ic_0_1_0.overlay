/*
 * Copyright (c) The Libre Solar Project Contributors
 *
 * SPDX-License-Identifier: Apache-2.0
 */

/ {
	pcb {
		version-str = "v0.1";
		version-num = <1>;
	};
};

&isl94202 {
	shunt-resistor-uohm = <1000>;
};
