## boards/arm/okai/new_defconfig
```kconfig
CONFIG_CELL_TYPE_NMC=y
CONFIG_NUM_CELLS_IN_SERIES=13
CONFIG_THINGSET_SERIAL=y
CONFIG_THINGSET_CAN=y
CONFIG_GPIO=y
CONFIG_I2C=y
CONFIG_UART_INTERRUPT_DRIVEN=y
CONFIG_PINCTRL=y
CONFIG_CLOCK_CONTROL=y
CONFIG_SERIAL=y
CONFIG_THINGSET=y
CONFIG_THINGSET_IMMUTABLE_SUBSETS=y
CONFIG_OKAI_PB2_POWER=y
CONFIG_SOC_SERIES_STM32F0X=y
CONFIG_SOC_STM32F072XB=y
CONFIG_THREAD_NAME=y
CONFIG_CONSOLE=y
CONFIG_UART_CONSOLE=y
CONFIG_PINMUX=y
CONFIG_CAN=y
CONFIG_HWINFO=y
CONFIG_NEWLIB_LIBC=y
CONFIG_NEWLIB_LIBC_FLOAT_PRINTF=y
CONFIG_REBOOT=y
CONFIG_CPLUSPLUS=y
CONFIG_LIB_CPLUSPLUS=y
CONFIG_LOG=y
CONFIG_LOG_MODE_MINIMAL=y
```

## boards/arm/okai/okai_defconfig
```kconfig
# SPDX-License-Identifier: Apache-2.0

CONFIG_SOC_SERIES_STM32F0X=y
CONFIG_SOC_STM32F072XB=y

CONFIG_CLOCK_CONTROL=y
CONFIG_PINCTRL=y
CONFIG_PINMUX=y

CONFIG_GPIO=y

CONFIG_SERIAL=y
CONFIG_UART_INTERRUPT_DRIVEN=y

CONFIG_CONSOLE=y
CONFIG_UART_CONSOLE=y

CONFIG_I2C=y

CONFIG_SPI=n
CONFIG_THINGSET=n
CONFIG_THINGSET_SERIAL=n
CONFIG_THINGSET_SERIAL_RX_BUF_SIZE=128
CONFIG_THINGSET_SERIAL_RX_BUF_SIZE=512
CONFIG_THINGSET_IMMUTABLE_SUBSETS=y
CONFIG_EEPROM=n
CONFIG_EEPROM_AT24=n
CONFIG_EEPROM_AT25=y

CONFIG_CAN=y

#from prj.conf
CONFIG_CELL_TYPE_NMC=y
CONFIG_NUM_CELLS_IN_SERIES=13

CONFIG_OKAI_PB2_POWER=y
```

## boards/libresolar/bms_15s80_sc/Kconfig.bms_15s80_sc
```kconfig
# Copyright (c) The Libre Solar Project Contributors
# SPDX-License-Identifier: Apache-2.0

config BOARD_BMS_15S80_SC
	select SOC_STM32F072XB
```

## boards/libresolar/bms_15s80_sc/board.yml
```yaml
board:
  name: bms_15s80_sc
  vendor: libresolar
  socs:
    - name: stm32f072xb
```

## boards/libresolar/bms_16s100_sc/Kconfig.bms_16s100_sc
```kconfig
# Copyright (c) The Libre Solar Project Contributors
# SPDX-License-Identifier: Apache-2.0

config BOARD_BMS_16S100_SC
	select SOC_STM32G0B1XX
```

## boards/libresolar/bms_16s100_sc/Kconfig.defconfig
```kconfig
# Copyright (c) The Libre Solar Project Contributors
# SPDX-License-Identifier: Apache-2.0

if BMS_IC

config BMS_IC_MAX_THERMISTORS
	default 2

endif # BMS_IC
```

## boards/libresolar/bms_16s100_sc/board.yml
```yaml
board:
  name: bms_16s100_sc
  vendor: libresolar
  socs:
    - name: stm32g0b1xx
```

## boards/libresolar/bms_5s50_sc/Kconfig.bms_5s50_sc
```kconfig
# Copyright (c) The Libre Solar Project Contributors
# SPDX-License-Identifier: Apache-2.0

config BOARD_BMS_5S50_SC
	select SOC_STM32F072XB
```

## boards/libresolar/bms_5s50_sc/Kconfig.defconfig
```kconfig
# Copyright (c) The Libre Solar Project Contributors
# SPDX-License-Identifier: Apache-2.0

if BMS_IC

config BMS_IC_MAX_CELLS
	default 5

config BMS_IC_MAX_THERMISTORS
	default 1

endif # BMS_IC
```

## boards/libresolar/bms_8s50_ic/Kconfig.bms_8s50_ic
```kconfig
# Copyright (c) The Libre Solar Project Contributors
# SPDX-License-Identifier: Apache-2.0

config BOARD_BMS_8S50_IC
	select SOC_STM32L452XX
```

## boards/libresolar/bms_8s50_ic/board.yml
```yaml
board:
  name: bms_8s50_ic
  vendor: libresolar
  socs:
    - name: stm32l452xx
  revision:
    format: major.minor.patch
    default: "0.2.0"
    revisions:
    - name: "0.2.0"
    - name: "0.1.0"
```

## boards/libresolar/bms_c1/Kconfig.bms_c1
```kconfig
# Copyright (c) The Libre Solar Project Contributors
# SPDX-License-Identifier: Apache-2.0

config BOARD_BMS_C1
        select SOC_ESP32C3_MINI_N4
```

## boards/libresolar/bms_c1/Kconfig.defconfig
```kconfig
# Copyright (c) The Libre Solar Project Contributors
# SPDX-License-Identifier: Apache-2.0

config ENTROPY_ESP32_RNG
	default y if ENTROPY_GENERATOR

config HEAP_MEM_POOL_SIZE
	default 98304 if WIFI
	default 40960 if BT
	default 4096

if BMS_IC

config BMS_IC_MAX_THERMISTORS
	default 2

endif # BMS_IC
```

## boards/libresolar/bms_c1/board.yml
```yaml
board:
  name: bms_c1
  vendor: libresolar
  socs:
    - name: esp32c3
  revision:
    format: major.minor.patch
    default: "0.4.0"
    revisions:
    - name: "0.4.0"
    - name: "0.3.0"
```

## boards/riscv/bms_16s100_sc_esp32c3/Kconfig.board
```kconfig
# Copyright (c) The Libre Solar Project Contributors
# SPDX-License-Identifier: Apache-2.0

config BOARD_BMS_16S100_SC_ESP32C3
	bool "Libre Solar BMS 16S100 SC"
	depends on SOC_ESP32C3
	select CONSOLE_HAS_DRIVER
```

## boards/riscv/bms_16s100_sc_esp32c3/Kconfig.defconfig
```kconfig
# Copyright (c) The Libre Solar Project Contributors
# SPDX-License-Identifier: Apache-2.0

config BOARD
	default "bms_16s100_sc_esp32c3"

config LIBRE_SOLAR_TYPE_ID
	default 10

config ENTROPY_ESP32_RNG
	default y if ENTROPY_GENERATOR

if BT

config HEAP_MEM_POOL_SIZE
	default 16384

choice BT_HCI_BUS_TYPE
	default BT_ESP32

endchoice

endif # BT
```

## boards/riscv/bms_c1/Kconfig.board
```kconfig
# Copyright (c) The Libre Solar Project Contributors
# SPDX-License-Identifier: Apache-2.0

config BOARD_BMS_C1
	bool "Libre Solar BMS C1"
	depends on SOC_SERIES_ESP32C3
```

## boards/riscv/bms_c1/Kconfig.defconfig
```kconfig
# Copyright (c) The Libre Solar Project Contributors
# SPDX-License-Identifier: Apache-2.0

if BOARD_BMS_C1

config BOARD
	default "bms_c1" if BOARD_BMS_C1

config ENTROPY_ESP32_RNG
	default y if ENTROPY_GENERATOR

config HEAP_MEM_POOL_SIZE
	default 98304 if WIFI
	default 40960 if BT
	default 4096

choice BT_HCI_BUS_TYPE
	default BT_ESP32 if BT
endchoice

endif # BOARD_BMS_C1

if BMS_IC

config BMS_IC_MAX_THERMISTORS
	default 2

endif # BMS_IC
```

## boards/riscv/bms_c1/bms_16s100_sc_esp32c3_defconfig
```kconfig
# SPDX-License-Identifier: Apache-2.0

CONFIG_BOARD_BMS_16S100_SC_ESP32C3=y
CONFIG_SOC_ESP32C3=y

CONFIG_CLOCK_CONTROL=y
CONFIG_SYS_CLOCK_TICKS_PER_SEC=1000

CONFIG_MAIN_STACK_SIZE=2048

CONFIG_GPIO=y
CONFIG_GPIO_ESP32=y

CONFIG_CONSOLE=y
CONFIG_SERIAL=y
CONFIG_UART_CONSOLE=y
CONFIG_UART_INTERRUPT_DRIVEN=y

CONFIG_I2C=y
```

## boards/riscv/bms_c1/bms_c1_defconfig
```kconfig
# SPDX-License-Identifier: Apache-2.0

CONFIG_BOARD_BMS_C1=y
CONFIG_SOC_SERIES_ESP32C3=y

CONFIG_CLOCK_CONTROL=y
CONFIG_SYS_CLOCK_TICKS_PER_SEC=1000

CONFIG_MAIN_STACK_SIZE=2048

CONFIG_GPIO=y

CONFIG_CONSOLE=y
CONFIG_SERIAL=y
CONFIG_UART_CONSOLE=y
CONFIG_UART_INTERRUPT_DRIVEN=y
```

## boards/shields/uext_oled/Kconfig.shield
```kconfig
# Copyright (c) The Libre Solar Project Contributors
# SPDX-License-Identifier: Apache-2.0

config SHIELD_UEXT_OLED
	def_bool $(shields_list_contains,uext_oled)
```

## drivers/bms_ic/Kconfig
```kconfig
# Copyright (c) The Libre Solar Project Contributors
# SPDX-License-Identifier: Apache-2.0

menuconfig BMS_IC
	bool "BMS IC drivers"
	help
	  Enable drivers for Battery Management System (BMS) front-end ICs.

if BMS_IC

config BMS_IC_HAS_SWITCHES
	bool
	help
	  Select to indicate that the IC supports controlling MOSFETs.

config BMS_IC_HAS_CURRENT_MONITORING
	bool
	help
	  Select to indicate that the IC supports current monitoring.

module = BMS_IC
module-str = bms_ic
source "subsys/logging/Kconfig.template.log_config"

config BMS_IC_BQ769X0
	bool "Texas Instruments bq769x0 series"
	depends on DT_HAS_TI_BQ769X0_ENABLED
	select BMS_IC_HAS_CURRENT_MONITORING
	select BMS_IC_HAS_SWITCHES
	select CRC
	default y
	help
	  Driver for TI bq769x0.

config BMS_IC_BQ769X2
	bool "Texas Instruments bq769x2 series"
	depends on DT_HAS_TI_BQ769X2_I2C_ENABLED || DT_HAS_TI_BQ769X2_SPI_ENABLED
	select BMS_IC_HAS_CURRENT_MONITORING
	select BMS_IC_HAS_SWITCHES
	select CRC
	default y
	help
	  Driver for TI bq76942, bq76952 and bq769142.

config BMS_IC_ISL94202
	bool "Intersil/Renesas ISL94202"
	depends on DT_HAS_RENESAS_ISL94202_ENABLED
	select BMS_IC_HAS_CURRENT_MONITORING
	select BMS_IC_HAS_SWITCHES
	default y
	help
	  Driver for Intersil/Renesas ISL94202.

config BMS_IC_ISL94202_NUM_CELLS
    int "Exact number of cells in series"
    range 3 8
    default 8
    help
      The exact number of cells used by the application is needed for configuration of the chip.

      Typical choices:
      - 3 for 12V NMC Li-Ion battery
      - 4 for 12V LiFePO4 battery
      - 5 for 12V Titanate battery
      - 8 for 24V LiFePO4 battery

config BMS_IC_CURRENT_MONITORING
	bool "Use BMS IC current monitoring"
	depends on BMS_IC_HAS_CURRENT_MONITORING
	default y
	help
	  Use the current monitoring features if available in the IC. Can be disabled to reduce
	  code size.

config BMS_IC_SWITCHES
	bool "Control switches via BMS IC"
	depends on BMS_IC_HAS_SWITCHES
	default y
	help
	  If available in the BMS IC, this config allows to manually control the MOSFETs for
	  charging, discharging or pre-charging.

config BMS_IC_MAX_CELLS
	int "Max. number of cells used"
	range 1 31
	default 16 if BMS_IC_BQ769X2
	default 15 if BMS_IC_BQ769X0
	default 8 if BMS_IC_ISL94202

config BMS_IC_MAX_THERMISTORS
	int "Max. number of thermistors used"
	range 1 255
	default 3

config BMS_IC_INIT_PRIORITY
	int "BMS IC driver initialization priority"
	range 0 99
	default 70
	help
	  System initialization priority for BMS IC driver.

config BMS_IC_POLLING_INTERVAL_MS
	int "BMS IC polling interval"
	range 100 10000
	default 500

endif
```

## drivers/serial/Kconfig.esp32
```kconfig
# SPDX-License-Identifier: Apache-2.0

DT_COMPAT_ESP32_USB_SERIAL := espressif,esp32-usb-serial

config SERIAL_ESP32_USB
	bool "ESP32 USB serial driver"
	default $(dt_compat_enabled,$(DT_COMPAT_ESP32_USB_SERIAL))
	select SERIAL_HAS_DRIVER
	select SERIAL_SUPPORT_INTERRUPT
	depends on SOC_ESP32C3
	help
	  Enable the ESP32 USB serial driver integrated in the JTAG
	  interface.
```
