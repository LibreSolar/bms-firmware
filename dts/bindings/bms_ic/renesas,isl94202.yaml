## dts/bindings/bms_ic/renesas,isl94202.yaml
```yaml
# Copyright (c) The Libre Solar Project Contributors
# SPDX-License-Identifier: Apache-2.0

description: Intersil/Renesas ISL94202 Standalone 3 to 8 Cell Li-Ion Battery Pack Monitor

compatible: "renesas,isl94202"

include: [ bms-ic-common.yaml, i2c-device.yaml ]

properties:
  pull-up-gpios:
    type: phandle-array
    required: false
    description: |
      GPIO to enable/disable the I2C pull-up resistors.

  used-cell-channels:
    type: int
    required: true
    description: |
      Bitset of cell channels used by the board.

      Example for 5s configuration: 0x1F
```

## dts/bindings/bms_ic/ti,bq769x0.yaml
```yaml
# Copyright (c) The Libre Solar Project Contributors
# SPDX-License-Identifier: Apache-2.0

description: Texas Instruments bq769x0 li-ion and li-phosphate battery monitor

compatible: "ti,bq769x0"

include: [ bms-ic-common.yaml, i2c-device.yaml ]

properties:
  alert-gpios:
    type: phandle-array
    required: true
    description: Alert interrupt of bq769x0

  used-cell-channels:
    type: int
    required: true
    description: |
      Bitset of cell channels used by the board. See below examples for the maximum number of
      cells supported by the different chips:

      bq76920 (3-5s):  0b0000_0000_0001_1111 = 0x001F
      bq76930 (6-10s): 0b0000_0011_1111_1111 = 0x03FF
      bq76940 (9-15s): 0b0111_1111_1111_1111 = 0x7FFF

  bus-pchg-gpios:
    type: phandle-array
    required: false
    description: |
      GPIO to enable/disable the bus pre-charge MOSFET.

  thermistor-beta:
    type: int
    default: 3435
    description: |
      Thermistor beta value.

      Default is typical value for Semitec 103AT-5 thermistor.
```

## dts/bindings/bms_ic/ti,bq769x2-common.yaml
```yaml
# Copyright (c) The Libre Solar Project Contributors
# SPDX-License-Identifier: Apache-2.0

include: bms-ic-common.yaml

properties:
  crc-enabled:
    type: boolean
    description: |
      Enable CRC for communication. This option depends on the exact part number used.

  alert-gpios:
    type: phandle-array
    required: true
    description: Alert interrupt of bq769x2

  used-cell-channels:
    type: int
    required: true
    description: |
      Bitset of cell channels used by the board. The supported channels for a particular chip
      correspond to the Settings:Configuration:Vcell Mode register. See below examples for the
      maximum number of cells supported by the different chips:

      bq76952 (3-16s):  0b1111_1111_1111_1111 = 0xFFFF
      bq769142 (3-14s): 0b1010_1111_1111_1111 = 0xAFFF
      bq76942 (3-10s):  0b0000_0011_1111_1111 = 0x03FF

  cfetoff-pin-config:
    type: int
    description: |
      Configuration of the CFETOFF pin. See Reference manual for details.

  dfetoff-pin-config:
    type: int
    description: |
      Configuration of the DFETOFF pin. See Reference manual for details.

  alert-pin-config:
    type: int
    description: |
      Configuration of the ALERT pin. See Reference manual for details.

  ts1-pin-config:
    type: int
    description: |
      Configuration of the TS1 pin. See Reference manual for details.

  ts2-pin-config:
    type: int
    description: |
      Configuration of the TS2 pin. See Reference manual for details.

  ts3-pin-config:
    type: int
    description: |
      Configuration of the TS3 pin. See Reference manual for details.

  hdq-pin-config:
    type: int
    description: |
      Configuration of the HDQ pin. See Reference manual for details.

  dchg-pin-config:
    type: int
    description: |
      Configuration of the DCHG pin. See Reference manual for details.

  ddsg-pin-config:
    type: int
    description: |
      Configuration of the DDSG pin. See Reference manual for details.

  cell-temp-pins:
    type: array
    required: true
    description: |
      Pins used for cell temperature sensing. The *-pin-config property of that pin has to be
      configured accordingly.

      Up to CONFIG_BMS_IC_MAX_THERMISTORS pins can be configured.

      See include/zephyr/dt-bindings/bms_ic/bq769x2.h for allowed values.

  fet-temp-pin:
    type: int
    enum:
      - 0 # CFETOFF
      - 1 # DFETOFF
      - 2 # ALERT
      - 3 # TS1
      - 4 # TS2
      - 5 # TS3
      - 6 # HDQ
      - 7 # DCHG
      - 8 # DDSG
    description: |
      Pin used for MOSFET temperature sensing. The *-pin-config property of that pin has to be
      configured accordingly.

      See include/zephyr/dt-bindings/bms_ic/bq769x2.h for allowed values.

  shunt-temp-pin:
    type: int
    enum:
      - 0 # CFETOFF
      - 1 # DFETOFF
      - 2 # ALERT
      - 3 # TS1
      - 4 # TS2
      - 5 # TS3
      - 6 # HDQ
      - 7 # DCHG
      - 8 # DDSG
    description: |
      Pin used for shunt temperature sensing. The *-pin-config property of that pin has to be
      configured accordingly.

      See include/zephyr/dt-bindings/bms_ic/bq769x2.h for allowed values.

  auto-pdsg:
    type: boolean
    description: |
      Enable automatic pre-discharge (bus precharge) before switching on DSG FETs.

  pdsg-timeout-ms:
    type: int
    default: 2000
    description: |
      Maximum duration of the PDSG (bus precharge) phase in milliseconds. The BQ76952
      transitions from PDSG to DSG when the bus voltage reaches the pack voltage minus
      PDSG Stop Delta, OR when this timeout expires, whichever happens first.

      Setting this to 0 disables the timeout (voltage-based exit only), which is NOT
      recommended for boards with current-limited precharge resistors: a short-circuit
      load prevents the voltage condition from ever being met, keeping PDSG active
      indefinitely and overloading the precharge resistor.

      Default 2000 ms covers a typical DC-link capacitance up to ~10 mF with safety
      margin. Set to 0 only if the precharge resistor can survive indefinite loading.

      Granularity is 10 ms (values are rounded down to nearest 10 ms). Maximum
      effective value is 2550 ms (BQ76952 TRM SLUUBY2B §13.3.6.5).

      Only relevant when auto-pdsg is set.

  pdsg-stop-delta-mv:
    type: int
    default: 500
    description: |
      Voltage delta in millivolts for the PDSG exit condition. PDSG ends when the LD pin
      voltage is within this delta of the top-of-stack voltage. Default 500 mV matches
      the BQ76952 factory default. Granularity is 10 mV, max 2550 mV.

      Only relevant when auto-pdsg is set.

  reg0-config:
    type: int
    default: 0
    description: |
      Configuration of the REG0 Config Register. REG0 is the pre-regulator for REG1/2 and must be
      enabled if REG1 or REG2 are used and REGIN is not supplied externally.
      Valid values: 0 and 1

  reg12-config:
    type: int
    default: 0
    description: |
      Configuration of the REG12 Config Register. REG2 is configured in the higher nibble and REG1
      in the lower nibble of this U1 register.
      Example: 0xDC to set both regulators to 3.3V and enable REG2 by default.

  max-balanced-cells:
    type: int
    default: 4
    description: |
      Maximum number of cells to be balanced at once. This board-specific value depends on the heat
      dissipation of the chip.
```

## tests/bms/testcase.yaml
```yaml
# SPDX-License-Identifier: Apache-2.0

tests:
  bms.common:
    integration_platforms:
      - native_posix
```

## tests/bms_ic/bq769x2/testcase.yaml
```yaml
# SPDX-License-Identifier: Apache-2.0

tests:
  bms_ic.bq769x2:
    integration_platforms:
      - native_posix
```

## tests/bms_ic/isl94202/testcase.yaml
```yaml
# SPDX-License-Identifier: Apache-2.0

tests:
  bms_ic.isl94202:
    integration_platforms:
      - native_sim
```

## tests/common/testcase.yaml
```yaml
# SPDX-License-Identifier: Apache-2.0

tests:
  common.bq769x2:
    integration_platforms:
      - native_posix
    extra_args:
      - DTC_OVERLAY_FILE="boards/bq769x2.overlay"
  common.isl94202:
    integration_platforms:
      - native_posix
    extra_args:
      - DTC_OVERLAY_FILE="boards/isl94202.overlay"
```

## tests/helper/testcase.yaml
```yaml
# SPDX-License-Identifier: Apache-2.0

tests:
  helper.test:
    integration_platforms:
      - native_posix
```

## zephyr/Kconfig
```kconfig
# Copyright (c) The Libre Solar Project Contributors
# SPDX-License-Identifier: Apache-2.0

mainmenu "Libre Solar Battery Management System Firmware"

#
# Invisible (board-specific) Kconfig symbols
#

config BMS_BQ76920
    bool
    help
      Texas Instruments bq76920 used as BMS IC

config BMS_BQ76930
    bool
    help
      Texas Instruments bq76930 used as BMS IC

config BMS_BQ76940
    bool
    help
      Texas Instruments bq76940 used as BMS IC

config BMS_ISL94202
    bool
    help
      Intersil ISL94202 used as BMS IC

config LIBRE_SOLAR_TYPE_ID
    int
    help
      Numeric Libre Solar hardware type ID

#
# Visible (user-configurable) Kconfig symbols
#

menu "Battery default settings"

config BAT_CAPACITY_AH
    int "Battery nominal capacity in Ah"
    range 10 1000
    default 50
    help
      Nominal battery capacity or sum of parallel cells capacity

choice
    prompt "Cell type"
    default CELL_TYPE_LFP
    help
      Select the type of the single cells inside the battery
      to determine voltage set points. Total voltage set points
      are multiplied with the selected number of cells.

    config CELL_TYPE_LFP
        bool "LiFePO4, 3.3V nominal"

    config CELL_TYPE_NMC
        bool "NMC/Graphite, 3.7V nominal, 4.2V max"

    config CELL_TYPE_NMC_HV
        bool "NMC/Graphite High Voltage, 3.7V nominal, 4.35 max"

    config CELL_TYPE_LTO
        bool "NMC/Titanate, 2.4 V nominal"
endchoice

# values must match enum CellType in bms.h
config CELL_TYPE
    int
    default 0 if CELL_TYPE_CUSTOM
    default 1 if CELL_TYPE_LFP
    default 2 if CELL_TYPE_NMC
    default 3 if CELL_TYPE_NMC_HV
    default 4 if CELL_TYPE_LTO

config NUM_CELLS_IN_SERIES
    int "Number of cells for single battery"
    default 3 if CELL_TYPE_NMC || CELL_TYPE_NMC_HV
    default 4 if CELL_TYPE_LFP
    default 5 if CELL_TYPE_LTO
    range 3 16
    help
      Typical choices:
      - 3 for 12V NMC Li-Ion battery
      - 4 for 12V LiFePO4 battery
      - 5 for 12V Titanate battery

endmenu


menu "UEXT port"

config UEXT_OLED_DISPLAY
    select I2C
    bool "OLED display"

config UEXT_OLED_BRIGHTNESS
    depends on UEXT_OLED_DISPLAY
    int "OLED display brightness"
    range 1 255
    default 1

config UEXT_SERIAL_THINGSET
    depends on THINGSET_SERIAL
    bool "Use UEXT serial for ThingSet interface"
    default y
    help
      If the ThingSet interface is not attached to the serial port in the UEXT connector, the
      serial in the LS.one port or the debug connector is used (if existing).

endmenu # UEXT port

menu "ThingSet interfaces"

config THINGSET_SERIAL
    bool "ThingSet serial interface"

config THINGSET_SERIAL_RX_BUF_SIZE
    depends on THINGSET_SERIAL
    int "ThingSet serial RX buffer size"
    range 64 2048
    default 512

config THINGSET_SERIAL_TX_BUF_SIZE
    depends on THINGSET_SERIAL
    int "ThingSet serial TX buffer size"
    range 256 2048
    default 1024

config THINGSET_SERIAL_PUB_DEFAULT
    bool "Enable serial publication messages at startup"
    depends on THINGSET_SERIAL
    default y

config THINGSET_CAN
    depends on CAN
    bool "ThingSet CAN interface"

config THINGSET_CAN_PUB_DEFAULT
    bool "Enable CAN publication messages at startup"
    depends on THINGSET_CAN
    default y

config THINGSET_CAN_DEFAULT_NODE_ID
    depends on THINGSET_CAN
    int "ThingSet CAN default node ID"
    range 0 255
    default 10

config THINGSET_EXPERT_PASSWORD
    depends on THINGSET_SERIAL || THINGSET_CAN
    string "ThingSet expert user password"
    default "expert123"

config THINGSET_MAKER_PASSWORD
    depends on THINGSET_SERIAL || THINGSET_CAN
    string "ThingSet maker password"
    default "maker456"

endmenu # ThingSet interface

# include main Zephyr menu entries from Zephyr root directory
source "Kconfig.zephyr"
```

## zephyr/dts/bindings/bms.yaml
```yaml
# Copyright (c) The Libre Solar Project Contributors
# SPDX-License-Identifier: Apache-2.0

description: Generic BMS device setup

compatible: "bms"

properties:
    type:
      type: string
      required: true
      description: Device type
    version-str:
      type: string
      required: true
      description: Hardware version number (human-readable)
    version-num:
      type: int
      required: true
      description: Hardware version number (usable in preprocessor defines)

    num-cells-max:
      type: int
      required: true
      description: "Maximum number of cells supported by this board"
    num-thermistors-max:
      type: int
      required: true
      description: "Maximum number of thermistors supported by this board"

    current-max:
      type: int
      description: Maximum charge/discharge current in amps
    shunt-res:
      type: int
      description: Resistance of shunt in micro-Ohms
```

## zephyr/dts/bindings/inputs.yaml
```yaml
# Copyright (c) 2020 Martin Jäger / Libre Solar
# SPDX-License-Identifier: Apache-2.0

description: GPIOs used for digital input

compatible: "inputs"

child-binding:
  description: GPIO digital inputs child node
  properties:
    gpios:
      type: phandle-array
      description: GPIO handle for input pin
    label:
      type: string
      required: true
      description: Human readable string describing the device (used by Zephyr for API name)
    present:
      type: int
      default: 1
    kconfig-flag:
      type: boolean
      description: This value can be checked by Kconfig parser using dt_node_has_bool_prop function
```

## zephyr/dts/bindings/renesas,isl94202.yaml
```yaml
# Copyright (c) The Libre Solar Project Contributors
# SPDX-License-Identifier: Apache-2.0

description: Intersil/Renesas ISL94202 Standalone 3 to 8 Cell Li-Ion Battery Pack Monitor

compatible: "renesas,isl94202"

include: i2c-device.yaml
```

## zephyr/dts/bindings/switch.yaml
```yaml
# Copyright (c) The Libre Solar Project Contributors
# SPDX-License-Identifier: Apache-2.0

description: GPIO pins to switch something on or off

compatible: "switch"

child-binding:
  description: GPIO switch child node
  properties:
    gpios:
      type: phandle-array
      required: true
    label:
      type: string
      required: true
      description: Human readable string describing the device (used by Zephyr for API name)
```

## zephyr/dts/bindings/ti,bq769x0.yaml
```yaml
#
# SPDX-License-Identifier: Apache-2.0
#
# Copyright (c) 2021 Libre Solar / Martin Jäger
#

description: Texas Instruments bq769x0 li-ion and li-phosphate battery monitor

compatible: "ti,bq769x0"

include: i2c-device.yaml

properties:
    alert-gpios:
      type: phandle-array
      required: true
      description: Alert interrupt of bq769x0
```

## zephyr/dts/bindings/ti,bq769x2-common.yaml
```yaml
# Copyright (c) The Libre Solar Project Contributors
# SPDX-License-Identifier: Apache-2.0

properties:
    alert-gpios:
      type: phandle-array
      required: true
      description: Alert interrupt of bq769x2
```

## zephyr/dts/bindings/ti,bq769x2-spi.yaml
```yaml
# Copyright (c) The Libre Solar Project Contributors
# SPDX-License-Identifier: Apache-2.0

description: |
    Texas Instruments BQ769x2 3s to 16s High Accuracy Battery Monitor and
    Protector for Li-Ion, Li-Polymer, and LiFePO4 Battery Packs (SPI)

compatible: "ti,bq769x2-spi"

include: ["ti,bq769x2-common.yaml", "spi-device.yaml"]
```
