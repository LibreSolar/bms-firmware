## zephyr/west.yml
```yaml
manifest:
  remotes:
    - name: zephyrproject-rtos
      url-base: https://github.com/zephyrproject-rtos
    - name: libresolar
      url-base: https://github.com/LibreSolar
    - name: thingset
      url-base: https://github.com/ThingSet
    - name: throwtheswitch
      url-base: https://github.com/ThrowTheSwitch
  projects:
    - name: zephyr
      remote: zephyrproject-rtos
      revision: v2.7-branch
      # path must be something else than zephyr as we get a Kconfig include recursion otherwise
      path: rtos
      import:
        # main zephyr modules should be placed in here into zephyr subdirectory
        path-prefix: zephyr
        # only get modules we actually need
        name-whitelist:
          - cmsis
          - edtt
          - hal_stm32
    - name: thingset-device-library
      remote: thingset
      revision: c3388d7a72e2d20760e7b4ad6c06b6b588849994
      path: zephyr/modules/thingset
    - name: unity
      path: zephyr/modules/unity
      revision: 74cde089e65c3435ce9aa87d5c69f4f16b7f6ade
      remote: throwtheswitch
```
