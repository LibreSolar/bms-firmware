/*
 * Copyright (c) The Libre Solar Project Contributors
 *
 * SPDX-License-Identifier: Apache-2.0
 */

/ {
        chosen {
                /*
                 * Workaround to speed up MCUboot 2nd stage bootloader.
                 * See: https://github.com/LibreSolar/bms-firmware/pull/78
                 */
                zephyr,console = &uart0;

                /*
                 * Same as MCUboot's default app.overlay, which is not applied because this
                 * board overlay takes precedence. Required since Zephyr v4.5 to flash MCUboot
                 * at the boot partition offset instead of slot 0.
                 */
                zephyr,code-partition = &boot_partition;
        };
};
