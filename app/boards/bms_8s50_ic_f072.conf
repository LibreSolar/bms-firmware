## app/boards/bms_8s50_ic_f072.conf
```kconfig
# Copyright (c) The Libre Solar Project Contributors
# SPDX-License-Identifier: Apache-2.0

CONFIG_EEPROM=y
CONFIG_EEPROM_AT24=y
```

## app/boards/bms_c1.conf
```kconfig
# Copyright (c) The Libre Solar Project Contributors
# SPDX-License-Identifier: Apache-2.0

# CAN
CONFIG_CAN=y
CONFIG_ISOTP=y
CONFIG_ISOTP_FAST=y
CONFIG_ENTROPY_GENERATOR=y

CONFIG_THINGSET_CAN=y

# Flash
CONFIG_MPU_ALLOW_FLASH_WRITE=y
CONFIG_FLASH=y
CONFIG_NVS=y
CONFIG_NVS_LOG_LEVEL_WRN=y

# Bluetooth
CONFIG_BT=y
CONFIG_BT_PERIPHERAL=y
CONFIG_BT_DEVICE_NAME="LibreSolar BMS-C1"
CONFIG_BT_DEVICE_NAME_DYNAMIC=y
CONFIG_BT_GATT_CLIENT=y

# Increase buffer sizes to allow long ATT values
CONFIG_BT_BUF_ACL_RX_SIZE=251
CONFIG_BT_BUF_ACL_TX_SIZE=251
CONFIG_BT_L2CAP_TX_MTU=251

CONFIG_THINGSET_BLE=y

CONFIG_SHELL=y
# Avoid conflicts with ThingSet ? command
CONFIG_SHELL_WILDCARD=n
# Support `select thingset` to run ThingSet requests directly
CONFIG_SHELL_CMDS_SELECT=y

CONFIG_THINGSET_SHELL=y
CONFIG_THINGSET_SHELL_REPORTING=n
CONFIG_THINGSET_SHELL_CMD_BUF_SIZE=256

# DFU over CAN
CONFIG_THINGSET_DFU=y

# Flash driver to store firmware image
CONFIG_FLASH=y
CONFIG_FLASH_MAP=y
CONFIG_FLASH_PAGE_LAYOUT=y
CONFIG_STREAM_FLASH=y
CONFIG_IMG_MANAGER=y
# progressive erase is required for this MCU, otherwise erasing the large SPI flash takes too long
CONFIG_IMG_ERASE_PROGRESSIVELY=y

# Application-side MCUboot configuration
CONFIG_BOOTLOADER_MCUBOOT=y
CONFIG_MCUBOOT_GENERATE_UNSIGNED_IMAGE=n
```

## app/boards/native_sim.conf
```kconfig
# Copyright (c) The Libre Solar Project Contributors
# SPDX-License-Identifier: Apache-2.0

# Enable I2C to emulate BMS
CONFIG_I2C=y

# Expose shell directly on the terminal
CONFIG_UART_NATIVE_PTY_0_ON_STDINOUT=y

CONFIG_LOG_MODE_DEFERRED=y
CONFIG_LOG_BACKEND_NATIVE_POSIX=y

CONFIG_GPIO=y

CONFIG_CAN=y
CONFIG_CAN_FD_MODE=y
CONFIG_ISOTP=y
CONFIG_ISOTP_FAST=y
CONFIG_THINGSET_CAN=y

CONFIG_SHELL=y
# Avoid conflicts with ThingSet ? command
CONFIG_SHELL_WILDCARD=n
# Support `select thingset` to run ThingSet requests directly
CONFIG_SHELL_CMDS_SELECT=y

CONFIG_THINGSET_SHELL=y
CONFIG_THINGSET_SHELL_REPORTING=n
CONFIG_THINGSET_SHELL_CMD_BUF_SIZE=256

CONFIG_EMUL=y
CONFIG_EEPROM=y

CONFIG_EVENTS=y

CONFIG_THINGSET_STORAGE=y

# Bluetooth
CONFIG_BT=y
CONFIG_BT_PERIPHERAL=y
CONFIG_BT_DEVICE_NAME="LibreSolar BMS-C1"
CONFIG_BT_DEVICE_NAME_DYNAMIC=y
CONFIG_BT_GATT_CLIENT=y

# Increase buffer sizes to allow long ATT values
CONFIG_BT_BUF_ACL_RX_SIZE=251
CONFIG_BT_BUF_ACL_TX_SIZE=251
CONFIG_BT_L2CAP_TX_MTU=251

CONFIG_THINGSET_BLE=y

# required to generate node ID in ThingSet
CONFIG_ENTROPY_GENERATOR=y
CONFIG_ENTROPY_DEVICE_RANDOM_GENERATOR=y

CONFIG_BMS_IC=y
CONFIG_BMS_IC_MAX_THERMISTORS=2
```

## app/sysbuild/mcuboot/boards/bms_c1.conf
```kconfig
# Copyright (c) The Libre Solar Project Contributors
# SPDX-License-Identifier: Apache-2.0

CONFIG_BOOT_UPGRADE_ONLY=y
CONFIG_BOOT_VALIDATE_SLOT0=n
CONFIG_BOOT_SIGNATURE_TYPE_NONE=y
CONFIG_BOOT_BANNER=n

CONFIG_SERIAL=n
CONFIG_UART_INTERRUPT_DRIVEN=n

CONFIG_CONSOLE=n
CONFIG_UART_CONSOLE=n

CONFIG_MCUBOOT_LOG_LEVEL_OFF=y
CONFIG_DEBUG=n

CONFIG_XIP=n
```

## boards/Kconfig
```kconfig
# SPDX-License-Identifier: Apache-2.0
# Copyright (c) 2019 Martin Jäger (Libre Solar)

#
# Invisible (board-specific) Kconfig symbols
#

config BMS_BQ76920
    bool
    default n
    help
      Texas Instruments bq76920 used as BMS IC

config BMS_BQ76930
    bool
    default n
    help
      Texas Instruments bq76930 used as BMS IC

config BMS_BQ76940
    bool
    default n
    help
      Texas Instruments bq76940 used as BMS IC

config BMS_ISL94202
    bool
    default n
    help
      Intersil ISL94202 used as BMS IC

config LIBRE_SOLAR_TYPE_ID
    int
    help
      Numeric Libre Solar hardware type ID

#
# Visible (user-configurable) Kconfig symbols
#

menu "Extensions and interfaces"

config EXT_OLED_DISPLAY
    bool "OLED display at UEXT"

config EXT_OLED_BRIGHTNESS
    depends on EXT_OLED_DISPLAY
    int "OLED display brightness"
    range 1 255
    default 1

config EXT_THINGSET_SERIAL
    bool "ThingSet serial interface"

config EXT_THINGSET_SERIAL_RX_BUF_SIZE
    depends on EXT_THINGSET_SERIAL
    int "ThingSet serial RX buffer size"
    range 64 2048
    default 512

config EXT_THINGSET_SERIAL_TX_BUF_SIZE
    depends on EXT_THINGSET_SERIAL
    int "ThingSet serial TX buffer size"
    range 256 2048
    default 1024

config EXT_THINGSET_CAN
    depends on CAN
    bool "ThingSet CAN interface"

config THINGSET_EXPERT_PASSWORD
    depends on EXT_THINGSET_SERIAL || EXT_THINGSET_CAN
    string "ThingSet expert user password"
    default "expert123"

config THINGSET_MAKER_PASSWORD
    depends on EXT_THINGSET_SERIAL || EXT_THINGSET_CAN
    string "ThingSet maker password"
    default "maker456"

endmenu
```

## boards/arm/bms8s50ic_f072cb/Kconfig.board
```kconfig
# Kconfig - Libre Solar BMS 8S50 IC board configuration
#
# Copyright (c) 2020 Libre Solar Technologies GmbH
#
# SPDX-License-Identifier: Apache-2.0
#

config BOARD_BMS8S50IC_F072
	bool "Libre Solar BMS 8S50 IC"
	depends on SOC_STM32F072XB
```

## boards/arm/bms8s50ic_l452cx/Kconfig.board
```kconfig
# Kconfig - Libre Solar BMS 8S50 IC board configuration
#
# Copyright (c) 2019 Libre Solar Technologies GmbH
#
# SPDX-License-Identifier: Apache-2.0
#

config BOARD_BMS8S50IC_L452CX
	bool "Libre Solar BMS 8S50 IC"
	depends on SOC_STM32L452XX
```

## boards/arm/bms_15s80_sc/Kconfig
```kconfig
# SPDX-License-Identifier: Apache-2.0
# Copyright (c) 2020 Martin Jäger / Libre Solar

# include generic BMS Kconfig
rsource "../../Kconfig"
```

## boards/arm/bms_15s80_sc/Kconfig.board
```kconfig
# Copyright (c) The Libre Solar Project Contributors
# SPDX-License-Identifier: Apache-2.0

config BOARD_BMS_15S80_SC
	bool "Libre Solar BMS 15S80 SC"
	depends on SOC_STM32F072XB
```

## boards/arm/bms_15s80_sc/Kconfig.defconfig
```kconfig
# Copyright (c) The Libre Solar Project Contributors
# SPDX-License-Identifier: Apache-2.0

if BOARD_BMS_15S80_SC

config BOARD
	default "bms_15s80_sc"

endif # BOARD_BMS_15S80_SC

if BMS_IC

config BMS_IC_MAX_THERMISTORS
	default 3

endif # BMS_IC
```

## boards/arm/bms_15s80_sc/bms_15s80_sc_defconfig
```kconfig
# SPDX-License-Identifier: Apache-2.0

CONFIG_SOC_SERIES_STM32F0X=y
CONFIG_SOC_STM32F072XB=y

CONFIG_CLOCK_CONTROL=y

CONFIG_PINCTRL=y

CONFIG_GPIO=y

CONFIG_SERIAL=y
CONFIG_UART_INTERRUPT_DRIVEN=y

CONFIG_CONSOLE=y
CONFIG_UART_CONSOLE=y

CONFIG_I2C=y

CONFIG_EEPROM=y
CONFIG_EEPROM_AT24=y

CONFIG_CAN=y

CONFIG_BMS_IC=y
CONFIG_BMS_IC_MAX_THERMISTORS=3
```

## boards/arm/bms_16s100_sc/Kconfig.board
```kconfig
# Copyright (c) The Libre Solar Project Contributors
# SPDX-License-Identifier: Apache-2.0

config BOARD_BMS_16S100_SC
	bool "Libre Solar BMS 16S100 SC"
	depends on SOC_STM32G0B1XX
```

## boards/arm/bms_16s100_sc/Kconfig.defconfig
```kconfig
# Copyright (c) The Libre Solar Project Contributors
# SPDX-License-Identifier: Apache-2.0

if BOARD_BMS_16S100_SC

config BOARD
	default "bms_16s100_sc"

endif # BOARD_BMS_16S100_SC
```

## boards/arm/bms_16s100_sc/bms_16s100_sc_defconfig
```kconfig
# SPDX-License-Identifier: Apache-2.0

CONFIG_SOC_SERIES_STM32G0X=y
CONFIG_SOC_STM32G0B1XX=y

CONFIG_ARM_MPU=y

CONFIG_CLOCK_CONTROL=y

CONFIG_PINCTRL=y

CONFIG_GPIO=y

CONFIG_SERIAL=y
CONFIG_UART_INTERRUPT_DRIVEN=y

CONFIG_CONSOLE=y
CONFIG_UART_CONSOLE=y

CONFIG_I2C=y

CONFIG_CAN=y
CONFIG_ISOTP=y
```

## boards/arm/bms_5s50_sc/Kconfig.board
```kconfig
# Copyright (c) The Libre Solar Project Contributors
# SPDX-License-Identifier: Apache-2.0

config BOARD_BMS_5S50_SC
	bool "Libre Solar BMS 5S50 SC"
	depends on SOC_STM32F072XB
```

## boards/arm/bms_5s50_sc/Kconfig.defconfig
```kconfig
# Copyright (c) The Libre Solar Project Contributors
# SPDX-License-Identifier: Apache-2.0

if BOARD_BMS_5S50_SC

config BOARD
	default "bms_5s50_sc"

endif # BOARD_BMS_5S50_SC

if BMS_IC

config BMS_IC_MAX_CELLS
	default 5

config BMS_IC_MAX_THERMISTORS
	default 1

endif # BMS_IC
```

## boards/arm/bms_5s50_sc/bms_5s50_sc_defconfig
```kconfig
# SPDX-License-Identifier: Apache-2.0

# Zephyr Kernel Configuration
CONFIG_SOC_SERIES_STM32F0X=y

# Platform Configuration
CONFIG_SOC_STM32F072XB=y

# General Kernel Options
CONFIG_SYS_CLOCK_HW_CYCLES_PER_SEC=48000000

# Clock configuration
CONFIG_CLOCK_CONTROL=y
# SYSCLK selection
CONFIG_CLOCK_STM32_HSE_CLOCK=8000000
CONFIG_CLOCK_STM32_SYSCLK_SRC_PLL=y
# PLL configuration
CONFIG_CLOCK_STM32_PLL_SRC_HSE=y

CONFIG_CLOCK_STM32_PLL_MULTIPLIER=6
CONFIG_CLOCK_STM32_AHB_PRESCALER=1
CONFIG_CLOCK_STM32_APB1_PRESCALER=1

CONFIG_PINMUX=y

CONFIG_GPIO=y

CONFIG_SERIAL=y
CONFIG_UART_INTERRUPT_DRIVEN=y

CONFIG_CONSOLE=y
CONFIG_UART_CONSOLE=y

CONFIG_I2C=y

CONFIG_EEPROM=y
CONFIG_EEPROM_AT24=y

CONFIG_CAN=y
```

## boards/arm/bms_8s50_ic/Kconfig.board
```kconfig
# Copyright (c) The Libre Solar Project Contributors
# SPDX-License-Identifier: Apache-2.0

config BOARD_BMS_8S50_IC
	bool "Libre Solar BMS 8S50 IC"
	depends on SOC_STM32L452XX
```

## boards/arm/bms_8s50_ic/Kconfig.defconfig
```kconfig
# Copyright (c) The Libre Solar Project Contributors
# SPDX-License-Identifier: Apache-2.0

if BOARD_BMS_8S50_IC

config BOARD
	default "bms_8s50_ic"

endif # BOARD_BMS_8S50_IC

if BMS_IC

config BMS_IC_MAX_THERMISTORS
	default 1

endif # BMS_IC
```

## boards/arm/bms_8s50_ic/bms_8s50_ic_defconfig
```kconfig
# SPDX-License-Identifier: Apache-2.0

CONFIG_SOC_SERIES_STM32L4X=y
CONFIG_SOC_STM32L452XX=y

CONFIG_ARM_MPU=y

CONFIG_CLOCK_CONTROL=y

CONFIG_PINCTRL=y

CONFIG_GPIO=y

CONFIG_SERIAL=y
CONFIG_UART_INTERRUPT_DRIVEN=y

CONFIG_CONSOLE=y
CONFIG_UART_CONSOLE=y
```

## boards/arm/bms_8s50_ic_f072/Kconfig.board
```kconfig
# Copyright (c) The Libre Solar Project Contributors
# SPDX-License-Identifier: Apache-2.0

config BOARD_BMS_8S50_IC_F072
	bool "Libre Solar BMS 8S50 IC"
	depends on SOC_STM32F072XB
```

## boards/arm/bms_8s50_ic_f072/Kconfig.defconfig
```kconfig
# Copyright (c) The Libre Solar Project Contributors
# SPDX-License-Identifier: Apache-2.0

if BOARD_BMS_8S50_IC_F072

config BOARD
	default "bms_8s50_ic_f072"

endif # BOARD_BMS_8S50_IC_F072
```

## boards/arm/bms_8s50_ic_l452/Kconfig.defconfig
```kconfig
# SPDX-License-Identifier: Apache-2.0
# Copyright (c) 2019 Libre Solar Technologies GmbH

if BOARD_BMS_8S50_IC_L452

config BOARD
	default "bms_8s50_ic_l452"

config LIBRE_SOLAR_TYPE_ID
	default 6

endif # BOARD_BMS_8S50_IC_L452
```

## boards/arm/okai/Kconfig.board
```kconfig
# Copyright (c) The Libre Solar Project Contributors
# SPDX-License-Identifier: Apache-2.0

config BOARD_OKAI
	bool "OKAI"
	depends on SOC_STM32F072XB

config OKAI_PB2_POWER
    bool "OKAI_PB2_POWER to enable HW"
	depends on BOARD_OKAI
```

## boards/arm/okai/Kconfig.defconfig
```kconfig
# Copyright (c) The Libre Solar Project Contributors
# SPDX-License-Identifier: Apache-2.0

if BOARD_OKAI

config BOARD
	default "okai"

config LIBRE_SOLAR_TYPE_ID
	default 128

endif # BOARD_OKAI
```
